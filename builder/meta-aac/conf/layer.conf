## builder/meta-aac/conf/layer.conf
```bitbake
# We have a conf and classes directory, add to BBPATH
BBPATH .= ":${LAYERDIR}"

# We have recipes-* directories, add to BBFILES
BBFILES += "${LAYERDIR}/recipes-*/*/*.bb \
	${LAYERDIR}/recipes-*/*/*.bbappend"

BBFILE_COLLECTIONS += "aac"
BBFILE_PATTERN_aac = "^${LAYERDIR}/"
BBFILE_PRIORITY_aac = "6"
LAYERSERIES_COMPAT_aac = "rocko thud zeus"

AAC_SCRIPTS_DIR = "${LAYERDIR}/../scripts"

# Import python aac module by default
OE_IMPORTS += "aac"

# Default installation path for AAC components
AAC_PREFIX ?= "${base_prefix}/opt/AAC"

# Determine CMake build type
AAC_BUILD_TYPE = "${@['RELEASE', 'DEBUG'][d.getVar('DEBUG_BUILD') == '1']}"

# Additional license directories.
LICENSE_PATH += "${LAYERDIR}/custom-licenses"
```
